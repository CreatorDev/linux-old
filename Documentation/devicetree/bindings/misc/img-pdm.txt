## Documentation/devicetree/bindings/misc/img-pdm.txt
```
Imagination Technologies Pulse Density Modulator (PDM) DAC.

Required properties:
- compatible: Must be "img,pistachio-pdm"
- clocks: phandle to input PDM clock
- clock-names: Must include the following entry:
  - pdm: input clock to pdm block.
- img,cr-periph: Must contain a phandle to the peripheral control
  syscon node which contains PDM control registers.
- #pdm-cells: Must be 2.
- The first cell is the PDM channel number (valid values: 0, 1, 2, 3)
- The second cell is 12-bit pulse-in value

Specifying PDM information for devices
======================================

1. PDM User nodes

PDM properties should be named "pdms". The exact meaning of each pdms property
is described above.

	pdm-specifier : array of #pdm-cells specifying the given PDM
						(controller specific)

The following example could be used to describe a PDM-based backlight device:

	pdm: pdm {
		#pdm-cells = <2>;
	};

	[...]

	bl: backlight {
		pdms = <&pdm 2 0>;
	};

pdm-specifier typically encodes the chip-relative PDM channel number and the
12-bit pulse-in value.

2. PDM Controller nodes

PDM controller nodes must specify the number of cells used for the specifier
using the '#pdm-cells' property.

An example PDM controller might look like this:

Example:
	pdm: pdm@18148000 {
		compatible = "img,pistachio-pdm";
		clocks = <&pdm_clk>;
		clk-names = "pdm";
		img,cr-periph = <&cr_periph>;
		#pdm-cells = <2>;
	};
```

## Documentation/devicetree/bindings/misc/img-scratchpad.txt
```
Imagination Technologies scratchpad driver

Provide syfs read/write access to the scratchpad registers.
These registers are soft reset protected registers.

Required properties:
- compatible: Should be "img,pistachio-scratchpad", "syscon"
- reg: Should contain scratchpad registers location and length
- clocks: Must contain an entry for each entry in clock-names.
- clock-names: Should contain "wdt" and "sys";
- sysfs-mask: 8 bit value should specify the registers to be exposed via sysfs

Examples:

scratchpad@18102120 {
	compatible = "img,pistachio-scratchpad", "syscon";
	reg = <0x18102120 0x20>;
	clocks = <&clk_periph PERIPH_CLK_WD>, <&cr_periph SYS_CLK_WD>;
	clock-names = "wdt", "sys";
	sysfs-mask = /bits/ 8 <0xFE>; /*expose all except the first reg */
};
```

## Documentation/devicetree/bindings/sound/img,i2s-in.txt
```
Imagination Technologies I2S Input Controller

Required Properties:

  - compatible : Compatible list, must contain "img,i2s-in"

  - #sound-dai-cells : Must be equal to 1

  - #sound-platform-cells : Must be equal to 1

  - reg : Offset and length of the register set for the device

  - clocks : Contains an entry for each entry in clock-names

  - clock-names : Must include the following entry:
	"sys"	The system clock

  - dmas: Contains an entry for each entry in dma-names.

  - dma-names: Must include one or both of the following:
	"rx"					Shared DMA channel
	"rxN" for N=0..img,i2s-channels - 1	Per-channel DMA

  - img,i2s-channels : Number of I2S channels instantiated in the I2S in block

  - img,cr-periph : Must contain a phandle to the peripheral control syscon
                    node which contains the alternate i2s control registers

Optional Properties:

  - img,clock-master : Contains bitmask for clock master configuration. One
		       bit per i2s channel for channels 0-3. 4/5 cannot be
		       modified and always use MFIO47/MFIO48. If omitted,
		       all channels will use MFIO47/MFIO48

	0 -> MFIO47 = bit clock, MFIO48 = left/right clock
	1 -> MFIO11 = bit clock, MFIO12 = left/right clock

  - img,shared-dma : Contains number of channels to combine for use with the
		     shared DMA channel. If this is not equal to the value
		     specified in img,i2s-channels, per-channel dma references
		     must exist for the remaining channels. If this is equal
		     to zero, the shared dma channel reference can be ommitted.
		     The combined channels must share the same bit and
		     left/right clock. If omitted, all channels will combined
		     for use with the shared DMA channel

  - interrupts : Contains the I2S in interrupts. Depending on
	the configuration, there may be no interrupts, one interrupt,
	or an interrupt per I2S channel

  - resets: Contains a phandle to the I2S in reset signal

  - reset-names: Contains the reset signal name "rst"

Example:

i2s_in: i2s-in@18100800 {
	compatible = "img,i2s-in";
	reg = <0x18100800 0x200>;
	interrupts = <GIC_SHARED 7 IRQ_TYPE_LEVEL_HIGH>;
	clocks = <&cr_periph SYS_CLK_I2S_IN>;
	clock-names = "sys";
	img,i2s-channels = <6>;
	img,cr-periph = <&cr_periph>;
	img,clock-master = <0xf>;
	img,shared-dma = <3>;
	dmas =  <&mdc 30 0xffffffff 0>,
		<&mdc 24 0xffffffff 0>,
		<&mdc 25 0xffffffff 0>,
		<&mdc 26 0xffffffff 0>,
		<&mdc 27 0xffffffff 0>,
		<&mdc 28 0xffffffff 0>,
		<&mdc 29 0xffffffff 0>;
	dma-names = "rx", "rx0", "rx1", "rx2",
		    "rx3", "rx4", "rx5";

	#sound-dai-cells = <1>;
	#sound-platform-cells = <1>;
};
```

## Documentation/devicetree/bindings/sound/img,pistachio-audio.txt
```
Imagination Technologies Pistachio Audio Card Driver

Required properties:

  - compatible : Compatible list, must contain "img,pistachio-audio"

  - clocks : Contains an entry for each entry in clock-names

  - clock-names : Includes the following entries:
        "audio_pll"  The audio PLL
        "i2s_mclk"   The i2s reference clock
                     Also connected to i2s_out_0_mclk output
        "dac_clk"    Dac reference clock. Connected to i2s_dac_clk output

  - img,cr-periph : phandle of the peripheral control syscon
                    node which contains the i2s loopback control registers

  - img,event-timer : phandle of event timer

Optional properties:

  - img,widgets : Please refer to widgets.txt

  - img,routing : A list of the connections between audio components.
              Each entry is a pair of strings, the first being the
              connection's sink, the second being the connection's
              source

  - img,mute-gpio : phandle of the mute gpio

  - img,hp-det-gpio : phandle of headphone detect gpio

  - img,i2s-clk-loopback : LRCLK+BCLK signals for i2s out and i2s in
			   controllers are connected internally

Optional subnodes:

  - spdif-out : Contains spdif out information

  - spdif-in : Contains spdif in information

  - parallel-out : Contains parallel out information

  - i2s-out : Contains i2s out information

  - i2s-in : Contains i2s in information

Required spdif-out subnode properties:

  - cpu-dai : phandle of spdif out cpu dai

Required spdif-in subnode properties:

  - cpu-dai : phandle of spdif in cpu dai

Required parallel-out subnode properties:

  - cpu-dai : phandle of parallel out cpu dai

  - sound-dai : phandle of internal dac

Required i2s-out subnode properties:

  - cpu-dai : phandle of i2s out cpu dai

  - format : I2S out format. "i2s" and "left_j" are supported by
		     the Pistachio iteration of the i2s out controller

Optional i2s-out subnode properties:

  - bitclock-inversion : i2s out BCLK inversion

  - frame-inversion : i2s out LRCLK inversion

  - continuous-clock : i2s out BCLK and LRCLK always active

Optional i2s-out subnodes:

  - <codec-name> : Contains codec information. <codec-name> will be used as
		   the prefix for the codec. This name must be unique for
		   each individual codec (unique codec device node), and
		   cannot be equal to "internal-dac". The name
		   should be short to avoid control name truncation

Required i2s-in subnode properties:

  - cpu-dai : phandle of i2s in cpu dai

  - format : i2s in format. "i2s" and "left_j" are supported by
	     the Pistachio iteration of the i2s in controller

Optional i2s-in subnode properties:

  - bitclock-inversion : i2s out BCLK inversion

  - frame-inversion : i2s out LRCLK inversion

  - continuous-clock : i2s out BCLK and LRCLK always active

Optional i2s-in subnodes:

  - <codec-name> : Contains codec information. <codec-name> will be used as
		   the prefix for the codec. This name must be unique for
		   each individual codec (unique codec device node), and
		   cannot be equal to "internal-dac". The name
		   should be short to avoid control name truncation

Required <codec-name> subnode properties:

  - mclk : Contains the mclk (master clock) used by the DAC/ADC.
	   Valid identifiers (dt-bindings/sound/pistachio-audio.h):

	       PISTACHIO_MCLK_NONE      No mclk is required, or mclk is
					provided externally with no software
					intervention required to compenstate
					for differing sample rates

	       PISTACHIO_MCLK_I2S       mclk is provided by the i2s_out_0_mclk
					output from pistachio SoC. This clock
					is shared with the internal i2s out
					controller

	       PISTACHIO_MCLK_DAC_CLK   mclk is provided by the i2s_dac_clk
					output from pistachio SoC

Required <codec-name> subnode properties if mclk is not PISTACHIO_MCLK_NONE:

  - mclk-fs : Contains the set of fs ratios the DAC/ADC accepts (Nfs for
	      sample rate r specifies the master clock input to the DAC is
	      N times r). It is assumed this set of ratios is applicable to
	      any given sample rate where this does not lead to a violation
	      of the minimum/maximum frequencies specified by mclk-min-freq
	      and mclk-max-freq respectively

  - mclk-min-freq : Contains the minimum frequency the DAC/ADC accepts for
		    its master clock input

  - mclk-max-freq : Contains the maximum frequency the DAC/ADC accepts for
		    its master clock input

Optional <codec-name> subnode properties:

  - sound-dai : phandle of the codec. If the codec does not accept/require
		software configuration, this can be omitted

  - mclk-index : Index of the mclk, used for snd_soc_dai_set_sysclk call.
		 0 is used if this property is omitted

  - frame-master : Indicates this codec is the LRCLK master

  - bitclock-master : Indicates this codec is the BCLK master

  frame-master and bitclock-master cannot exist in more than one of the codec
  subnodes

  frame-master and bitclock-master cannot be used within i2s out codec subnodes
  as the Pistachio iteration of the i2s out controller accepts master mode
  only

  frame-master and bitclock-master can be omitted if img,i2s-clk-loopback is
  used, or if LRCLK/BCLK generation does not require software intervention (eg
  a codec operating in hardware-mode)

Example 1 (Pistachio Bring-Up Board With Codec Daughterboard Inserted):

All audio components present on board. 2x pcm3168a codecs provide 3 i2s in
and out channels each. dac_clk provides the single master clock to both
codecs. The Pistachio i2s out controller is the LRCLK+BCLK master for the DAC
path. The second pcm3168a codec is the LRCLK+BCLK master for the ADC path

pistachio_audio_card {
	compatible = "img,pistachio-audio";

	clocks = <&clk_core CLK_AUDIO_PLL>,
		 <&clk_core CLK_I2S_DIV>,
		 <&clk_core CLK_AUDIO>;
	clock-names = "audio_pll", "i2s_mclk", "dac_clk";

	img,cr-periph = <&cr_periph>;
	img,event-timer = <&event_timer>;

	img,mute-gpio = <&gpio5 1 GPIO_ACTIVE_LOW>;
	img,hp-det-gpio = <&gpio5 3 GPIO_ACTIVE_LOW>;

	img,widgets = "Headphone", "Headphones",
		      "Speaker", "Speakers",
		      "Line", "RCA Out";

	img,routing = "Headphones", "internal-dac AOUTL",
		      "Headphones", "internal-dac AOUTR",
		      "Speakers", "internal-dac AOUTL",
		      "Speakers", "internal-dac AOUTR",
		      "RCA Out", "internal-dac AOUTL",
		      "RCA Out", "internal-dac AOUTR";

	spdif-out {
		cpu-dai = <&spdif_out>;
	};

	spdif-in {
		cpu-dai = <&spdif_in>;
	};

	parallel-out {
		cpu-dai = <&parallel_out>;
		sound-dai = <&internal_dac>;
	};

	i2s-out {
		cpu-dai = <&i2s_out>;
		format = "i2s";

		pcm3168a-1 {
			mclk = <PISTACHIO_MCLK_DAC_CLK>;
			mclk-fs = <128 192 256 384 512 768>;
			mclk-min-freq = <2048000>;
			mclk-max-freq = <36864000>;
			sound-dai = <&pcm3168a_1 0>;
		};

		pcm3168a-2 {
			mclk = <PISTACHIO_MCLK_DAC_CLK>;
			mclk-fs = <128 192 256 384 512 768>;
			mclk-min-freq = <2048000>;
			mclk-max-freq = <36864000>;
			sound-dai = <&pcm3168a_2 0>;
		};
	};

	i2s-in {
		cpu-dai = <&i2s_in>;
		format = "i2s";

		pcm3168a-1 {
			mclk = <PISTACHIO_MCLK_DAC_CLK>;
			mclk-fs = <256 384 512 768>;
			mclk-min-freq = <2048000>;
			mclk-max-freq = <36864000>;
			sound-dai = <&pcm3168a_1 1>;
		};

		pcm3168a-2 {
			mclk = <PISTACHIO_MCLK_DAC_CLK>;
			mclk-fs = <256 384 512 768>;
			mclk-min-freq = <2048000>;
			mclk-max-freq = <36864000>;
			sound-dai = <&pcm3168a_2 1>;
			frame-master;
			bitclock-master;
		};
	};
};
```
