## drivers/misc/atu/Kconfig
```kconfig
config ATU
	tristate "ATU Clock IP"
	---help---
	  Say Y here if you want to use ATU Clock IP.
	  If you select to build as a module it will be called atu_clk_driver.
```

## drivers/net/wireless/uccp420wlan/Kconfig
```kconfig
#
# Imagination Wireless drivers
#

config UCCP420WLAN
	tristate "Imagination UCCP420 WLAN"
	depends on MAC80211 && CFG80211

	---help---
          Imagination technologies UCCP420 WLAN driver
```

## drivers/soc/img/Kconfig
```kconfig
menuconfig SOC_IMG
        bool "IMG SOC drivers support"

if SOC_IMG

config IMG_EFUSE
	tristate "Imagination Technologies Generic eFuse driver"
	depends on HAS_IOMEM
	help
	  Imagination Technologies Generic eFuse driver which exposes the status
	  of 128 EFUSE bits.

	  To compile this driver as a module, choose M here: the module will
	  be called img-efuse.

config IMG_CONNECTIVITY
	tristate "Imagination Technologies UCCP base driver"
	depends on HAS_IOMEM && CMA
	default m
	help
	  Imagination Technologies UCCP driver which loads the firmware
	  and sets it up for operation. Drivers providing separate
	  features like Bluetooth or WLAN use this driver.

	  To compile this driver as a module, choose M here: the module will
	  be called img-connectivity.

config IMG_HOSTPORT
	tristate "Imagination Technologies Hostport driver"
	depends on IMG_CONNECTIVITY
	default m
	help
	  Imagination Technologies Hostport driver which provides the API to
	  communicate with the UCCP through shared memory.

	  To compile this driver as a module, choose M here: the module will
	  be called img-hostport.

config IMG_HOSTPORT_DUMMY_CLIENT
	tristate "Imagination Technologies Hostport dummy client"
	depends on IMG_HOSTPORT
	default n
	help
	  An example how to use the API exported by the Hostport driver.

	  To compile this driver as a module, choose M here: the module will
	  be called img-hostport.

endif # SOC_IMG
```

## sound/soc/img/Kconfig
```kconfig
config SND_SOC_IMG
	bool "Audio support for Imagination Technologies designs"
	depends on MACH_PISTACHIO
	help
	  Audio support for Imagination Technologies audio hardware

config SND_SOC_IMG_I2S_IN
	tristate "Imagination I2S Input Device Driver"
	depends on SND_SOC_IMG
	select SND_SOC_GENERIC_DMAENGINE_PCM
	help
	  Say Y or M if you want to add support for I2S in driver for
	  Imagination Technologies I2S in device.

config SND_SOC_IMG_I2S_OUT
	tristate "Imagination I2S Output Device Driver"
	depends on SND_SOC_IMG
	select SND_SOC_GENERIC_DMAENGINE_PCM
	help
	  Say Y or M if you want to add support for I2S out driver for
	  Imagination Technologies I2S out device.

config SND_SOC_IMG_PARALLEL_OUT
	tristate "Imagination Parallel Output Device Driver"
	depends on SND_SOC_IMG
	select SND_SOC_GENERIC_DMAENGINE_PCM
	help
	  Say Y or M if you want to add support for parallel out driver for
	  Imagination Technologies parallel out device.

config SND_SOC_IMG_SPDIF_IN
	tristate "Imagination SPDIF Input Device Driver"
	depends on SND_SOC_IMG
	select SND_SOC_GENERIC_DMAENGINE_PCM
	help
	  Say Y or M if you want to add support for SPDIF input driver for
	  Imagination Technologies SPDIF input device.

config SND_SOC_IMG_SPDIF_OUT
	tristate "Imagination SPDIF Output Device Driver"
	depends on SND_SOC_IMG
	select SND_SOC_GENERIC_DMAENGINE_PCM
	help
	  Say Y or M if you want to add support for SPDIF out driver for
	  Imagination Technologies SPDIF out device.


config SND_SOC_IMG_PISTACHIO_EVENT_TIMER
	tristate "Support for Pistachio SoC Event Timer Driver"
	depends on SND_SOC_IMG

config SND_SOC_IMG_PISTACHIO_INTERNAL_DAC
	tristate "Support for Pistachio SoC Internal DAC Driver"
	depends on SND_SOC_IMG
	help
	  Say Y or M if you want to add support for Pistachio internal DAC
	  driver for Imagination Technologies Pistachio internal DAC device.


config SND_SOC_IMG_PISTACHIO_BUB
	tristate "Audio support for Pistachio Bring-Up Board"
	depends on SND_SOC_IMG
	select SND_SOC_IMG_I2S_IN
	select SND_SOC_IMG_I2S_OUT
	select SND_SOC_IMG_PARALLEL_OUT
	select SND_SOC_IMG_SPDIF_IN
	select SND_SOC_IMG_SPDIF_OUT
	select SND_SOC_IMG_PISTACHIO_EVENT_TIMER
	select SND_SOC_PCM3168A_I2C
	select SND_SOC_PCM3168A_SPI
	select SND_SOC_PCM3060_I2C
	select SND_SOC_PCM3060_SPI
	select SND_SOC_TPA6130A2
	help
	  Audio support for Imagination Technologies Pistachio Bring-Up Board
```
