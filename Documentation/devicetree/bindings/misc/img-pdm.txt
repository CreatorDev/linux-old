## Documentation/devicetree/bindings/sound/img,pistachio-bub-audio.txt
```
Imagination Technologies Pistachio Bring-Up Board (BuB) Audio Card Driver



Required properties:

  - compatible : Compatible list, must contain "img,pistachio-bub-audio"

  - clocks : Contains an entry for each entry in clock-names

  - clock-names : Includes the following entries:
        "audio_pll"  The audio PLL
        "i2s_mclk"   The i2s reference clock
                     Also connected to i2s_out_0_mclk output
        "dac_clk"    Dac reference clock. Connected to i2s_dac_clk output
        "evt_clk"    Event timer internal clock

  - img,daughterboard : Contains daughterboard type. Valid identifiers
                        (dt-bindings/sound/pistachio-bub-audio.h):

        PISTACHIO_DAUGHTERBOARD_NONE       No daughterboard is connected, or
                                           CN20 is not bridged
        PISTACHIO_DAUGHTERBOARD_CODEC      The codec daughterboard is connected
                                           and CN20 is bridged
        PISTACHIO_DAUGHTERBOARD_BREAKOUT   The breakout daughterboard is
                                           connected and CN20 is bridged

  - img,mclk : Contains the mclk (master clock) source used by any codecs or
               other external components.
               Valid identifiers (dt-bindings/sound/pistachio-bub-audio.h):

        PISTACHIO_MCLK_NONE      No mclk is required, or mclk is provided
                                 externally with no software intervention
                                 required to compenstate for differing sample
                                 rates

        PISTACHIO_MCLK_I2S       mclk is provided by the i2s_out_0_mclk output
                                 from pistachio SoC. This clock is shared with
                                 the internal i2s out controller

        PISTACHIO_MCLK_DAC_CLK   mclk is provided by the i2s_dac_clk output
                                 from pistachio SoC

  - img,cr-periph : Must contain a phandle to the peripheral control syscon
                    node which contains the i2s loopback control registers

  - img,cr-top : Must contain a phandle to the top level control syscon
                    node which contains the internal dac control registers

  - img,event-timer : Must contain a reference to the event timer device node

Optional properties:

  - img,mclk-max : Contains a max constraint for the mclk rate. By default,
                   the max rate is set to ULONG_MAX when the breakout board is
                   used, else the max frequency supported by the pcm3060 and
                   pcm3168a codecs (36.864Mhz)

  - widgets : Please refer to widgets.txt

  - routing : A list of the connections between audio components.
              Each entry is a pair of strings, the first being the
              connection's sink, the second being the connection's
              source

Optional subnodes:

  - spdif_out : Contains spdif out information

  - spdif_in : Contains spdif in information

  - parallel_out : Contains parallel out information

  - i2s_out : Contais i2s out information

  - i2s_in : Contains i2s in information

Required spdif_out subnode properties:

  - cpu-dai : phandle of spdif out cpu dai

Required spdif_in subnode properties:

  - cpu-dai : phandle of spdif in cpu dai

Required parallel_out subnode properties:

  - cpu-dai : phandle of parallel out cpu dai

Optional parallel_out subnode properties:

  - tpa6130a2 : phandle of the tpa6130a2 codec. Can be omitted
                if the codec is bypassed

Required i2s_out subnode properties:

  - cpu-dai : phandle of i2s out cpu dai

  - cpu-format : i2s out cpu format. "i2s" and "left_j" are supported by
                 the pistachio BuB iteration of the img i2s out controller

Optional i2s_out subnode properties:

  - cpu-bitclock-inversion : i2s out cpu BCLK inversion

  - cpu-frame-inversion : i2s out cpu LRCLK inversion

  - cpu-continuous-clock : i2s out BCLK and LRCLK always active

  - pcm3060 : phandle to pcm3060 codec (DAC). This should be present if
              img,daughterboard is set to PISTACHIO_DAUGHTERBOARD_NONE and
              the main board switches are set to I2C or SPI control for the
              pcm3060. Do not include this if hardware control is selected
              for the pcm3060 codec. This codec is connected to i2s out
              channel 0

  - pcm3060-format : i2s format. "i2s", "left_j" and "right_j" are supported
                     by the pcm3060

  - pcm3060-bitclock-inversion : i2s BCLK inversion used by pcm3060

  - pcm3060-frame-inversion : i2s LRCLK inversion used by pcm3060

  - pcm3168a-1 : phandle to 1st pcm3168a codec (DAC). This should be present if
              img,daughterboard is set to PISTACHIO_DAUGHTERBOARD_CODEC and
              the codec daughterboard switches are set to I2C or SPI control
              for the pcm3168a codecs. Do not include this if hardware control
              is selected for the pcm3168a codecs. This codec is connected to
              i2s out channels 0,1,2

  - pcm3168a-1-format : i2s format. "i2s", "left_j", "right_j", "dsp_a" and
                        "dsp_b" are supported by the pcm3168a

  - pcm3168a-1-bitclock-inversion : i2s BCLK inversion used by pcm3168a-1

  - pcm3168a-1-frame-inversion : i2s LRCLK inversion used by pcm3168a-1

  - pcm3168a-2 : phandle to 2nd pcm3168a codec (DAC). This should be present if
              img,daughterboard is set to PISTACHIO_DAUGHTERBOARD_CODEC and
              the codec daughterboard switches are set to I2C or SPI control
              for the pcm3168a codecs. Do not include this if hardware control
              is selected for the pcm3168a codecs. This codec is connected to
              i2s out channels 3,4,5

  - pcm3168a-2-format : i2s format. "i2s", "left_j", "right_j", "dsp_a" and
                        "dsp_b" are supported by the pcm3168a

  - pcm3168a-2-bitclock-inversion : i2s BCLK inversion used by pcm3168a-2

  - pcm3168a-2-frame-inversion : i2s LRCLK inversion used by pcm3168a-2

  - clock-master : phandle of the i2s out BCLK and LRCLK master. If these
                   clocks are not required, or provided externally under
                   hardware control, this may be omitted

Required i2s_out subnode properties:

  - cpu-dai : phandle of i2s in cpu dai

  - cpu-format : i2s in cpu format. "i2s" and "left_j" are supported by
                 the pistachio BuB iteration of the img i2s in controller

Optional i2s_out subnode properties:

  - cpu-bitclock-inversion : i2s in cpu BCLK inversion

  - cpu-frame-inversion : i2s in cpu LRCLK inversion

  - pcm3060 : phandle to pcm3060 codec (ADC). This should be present if
              img,daughterboard is set to PISTACHIO_DAUGHTERBOARD_NONE and
              the main board switches are set to I2C or SPI control for the
              pcm3060. Do not include this if hardware control is selected
              for the pcm3060 codec. This codec is connected to i2s in
              channel 0

  - pcm3060-format : i2s format. "i2s", "left_j" and "right_j" are supported
                     by the pcm3060

  - pcm3060-bitclock-inversion : i2s BCLK inversion used by pcm3060

  - pcm3060-frame-inversion : i2s LRCLK inversion used by pcm3060

  - pcm3168a-1 : phandle to 1st pcm3168a codec (ADC). This should be present if
              img,daughterboard is set to PISTACHIO_DAUGHTERBOARD_CODEC and
              the codec daughterboard switches are set to I2C or SPI control
              for the pcm3168a codecs. Do not include this if hardware control
              is selected for the pcm3168a codecs. This codec is connected to
              i2s in channels 0,1,2

  - pcm3168a-1-format : i2s format. "i2s", "left_j", "right_j", "dsp_a" and
                        "dsp_b" are supported by the pcm3168a

  - pcm3168a-1-bitclock-inversion : i2s BCLK inversion used by pcm3168a-1

  - pcm3168a-1-frame-inversion : i2s LRCLK inversion used by pcm3168a-1

  - pcm3168a-2 : phandle to 2nd pcm3168a codec (ADC). This should be present if
              img,daughterboard is set to PISTACHIO_DAUGHTERBOARD_CODEC and
              the codec daughterboard switches are set to I2C or SPI control
              for the pcm3168a codecs. Do not include this if hardware control
              is selected for the pcm3168a codecs. This codec is connected to
              i2s in channels 3,4,5

  - pcm3168a-2-format : i2s format. "i2s", "left_j", "right_j", "dsp_a" and
                        "dsp_b" are supported by the pcm3168a

  - pcm3168a-2-bitclock-inversion : i2s BCLK inversion used by pcm3168a-2

  - pcm3168a-2-frame-inversion : i2s LRCLK inversion used by pcm3168a-2

  - clock-master : phandle of the i2s in BCLK and LRCLK master. If these
                   clocks are not required, or provided externally under
                   hardware control, this may be omitted. There is an internal
                   loopback available that allows the i2s out BCLK/LRCLK to be
                   used for the i2s in block. Link to the i2s out cpu node
                   to use this

Example:

pistachio_audio_card {
	compatible = "img,pistachio-bub-audio";

	clocks = <&clk_core CLK_AUDIO_PLL &clk_core CLK_I2S_DIV
	          &clk_core CLK_AUDIO &event_timer>;
	clock-names = "audio_pll", "i2s_mclk", "dac_clk", "evt_clk";

	img,daughterboard = <PISTACHIO_DAUGHTERBOARD_CODEC>;
	img,mclk = <PISTACHIO_MCLK_DAC_CLK>;
	img,cr-periph = <&cr_periph>;
	img,cr-top = <&cr_top>;
	img,event-timer = <&event_timer>;

	spdif_out: spdif_out {
		cpu-dai = <&spdif_out_cpu>;
	};

	spdif_in: spdif_in {
		cpu-dai = <&spdif_in_cpu>;
	};

	parallel_out: parallel_out {
		cpu-dai = <&parallel_out_cpu>;
		tpa6130a2 = <&tpa6130a2>;
	};

	i2s_out: i2s_out {
		cpu-dai = <&i2s_out_cpu>;
		cpu-format = "i2s";
		pcm3168a-1 = <&pcm3168a_1 0>;
		pcm3168a-1-format = "i2s";
		pcm3168a-2 = <&pcm3168a_2 0>;
		pcm3168a-2-format = "i2s";
		clock-master = <&i2s_out_cpu>;
	};

	i2s_in: i2s_in {
		cpu-dai = <&i2s_in_cpu>;
		cpu-format = "i2s";
		pcm3168a-1 = <&pcm3168a_1 1>;
		pcm3168a-1-format = "i2s";
		pcm3168a-2 = <&pcm3168a_2 1>;
		pcm3168a-2-format = "i2s";
		clock-master = <&pcm3168a_2 1>;
	};
};
```

## Documentation/devicetree/bindings/sound/img,pistachio-event-timer.txt
```
Imagination Technologies Pistachio Event Timer

Required properties:

  - compatible : Compatible list, must contain "img,pistachio-event-timer"

  - reg : Offset and length of the register set for the device

  - interrupts : Must contain an entry for each of the three interrupts below.
		 Order must also match the below:

		 Internal interrupt 1
		 Internal interrupt 2
		 Internal interrupt 3
		 Event trigger 0
		 Event trigger 1

  - #clock-cells : Must be 0

  - clocks : Must contain an entry for each entry in clock-names
	See ../clock/clock-bindings.txt for details

  - clock-names : Must include the following entries:
	"sys"	The system clock
	"ref0"	Reference clock 0
	"ref1"	Reference clock 1

		If ATU (in adjustable pll mode) is to be used, the
		following is required:
	"pll"	Audio PLL

  - img,clk-select : Reference select

Optional properties:

  - img,clk-rate : Initial internal clock rate

Example:

event_timer: event_timer@18102300 {
	compatible = "img,pistachio-event-timer";
	reg = <0x18102300 0x400>;
	assigned-clocks = <&clk_core CLK_EVENT_TIMER_MUX>;
	assigned-clock-parents = <&clk_core CLK_AUDIO_PLL_MUX>;
	interrupts = <GIC_SHARED 53 IRQ_TYPE_LEVEL_HIGH>,
		     <GIC_SHARED 54 IRQ_TYPE_LEVEL_HIGH>,
		     <GIC_SHARED 55 IRQ_TYPE_LEVEL_HIGH>,
		     <GIC_SHARED 56 IRQ_TYPE_LEVEL_HIGH>,
		     <GIC_SHARED 57 IRQ_TYPE_LEVEL_HIGH>;
	#clock-cells = <0>;
	clocks = <&clk_core SYS_CLK_EVENT_TIMER &clk_core CLK_AUDIO &clk_core CLK_EVENT_TIMER>;
	clock-names = "sys","ref0","ref1";
	img,clk-select = <1>;
	img,clk-rate = <12288000>;
};
```

## Documentation/devicetree/bindings/sound/img,pistachio-internal-dac.txt
```
Pistachio internal DAC DT bindings

Required properties:

  - compatible: "img,pistachio-internal-dac"

  - img,cr-top : Must contain a phandle to the top level control syscon
		 node which contains the internal dac control registers

  - img,voltage-select : Contains the voltage provided to the internal DAC:
		0 -> 1.8V
		1 -> 3.3V

Examples:

internal_dac: internal-dac {
	compatible = "img,pistachio-internal-dac";
	img,cr-top = <&cr_top>;
	img,voltage-select = <0>;
};
```

## Documentation/devicetree/bindings/sound/ti,pcm3060.txt
```
Texas Instruments pcm3060 DT bindings

This driver supports both SPI and I2C bus access for this codec

Required properties:

  - compatible: "ti,pcm3060"

  - clocks : Contains an entry for each entry in clock-names

  - clock-names : Includes the following entries:
	"sckid"	The DAC system clock
	"sckia"	The ADC system clock

  - VDD-supply : Digital power supply regulator (+3.3V)

  - VCC-supply : Analogue power supply regulator (+5V)

For required properties on SPI/I2C, consult SPI/I2C device tree documentation

Examples:

i2c0: i2c0@0 {

	...

	pcm3060: audio-codec@46 {
		compatible = "ti,pcm3060";
		reg = <0x46>;
		clocks = <&clk_core CLK_I2S>,
			 <&clk_core CLK_I2S>;
		clock-names = "sckid", "sckia";
		VCC-supply = <&supply5v0>;
		VDD-supply = <&supply3v3>;
		pinctrl-names = "default";
		pinctrl-0 = <&i2s_mclk_pin>;
	};
};
```

## Documentation/devicetree/bindings/uccp/uccp-img-pistachio.txt
```
IMG UCCP420 driver properties

Required Properties:
- compatible: "img,pistachio-uccp"
- reg: RPU registers
- reg-names : Should containt the names of the registers used by the driver
- interrupts: Interrupt number used by the RPU
- clocks : Should contain a clock specifier for each entry in clock-names
- clock-names : Should contain the clock names used by the driver
- io-channels : Names of the channels used by the driver

Example:

wifi: uccp@18480000 {
	      status = "disabled";
	      compatible = "img,pistachio-uccp";
	      reg = <0x18480000 0x38000>, <0x184BC000 0x2800>, <0x1a000000 0x00066cc0>;
	      reg-names = "uccp_core_base", "uccp_slave_base" , "uccp_pkd_gram_base";
	      interrupts = <GIC_SHARED 67 IRQ_TYPE_LEVEL_HIGH>;
	      interrupt-names = "uccpirq";
	      clocks = <&clk_core CLK_RPU_CORE>,
		     <&clk_core CLK_RPU_CORE_DIV>,
		     <&clk_core CLK_RPU_V>,
		     <&clk_core CLK_RPU_L>,
		     <&clk_core CLK_RPU_SLEEP>,
		     <&clk_core CLK_WIFI_PLL>,
		     <&clk_core CLK_WIFI_ADC>,
		     <&clk_core CLK_WIFI_DAC>,
		     <&clk_core CLK_EVENT_TIMER>,
		     <&cr_periph SYS_CLK_EVENT_TIMER>,
		     <&clk_core CLK_AUX_ADC>,
		     <&clk_core CLK_AUX_ADC_INTERNAL>;
	      clock-names = "rpu_core", "rpu_core_div", "rpu_v", "rpu_l", "rpu_sleep",
		      "wifi_pll", "wifi_adc", "wifi_dac", "event_timer",
		      "sys_event_timer", "aux_adc", "aux_adc_internal";
	      assigned-clocks = <&clk_core CLK_RPU_L_DIV>,
		      <&clk_core CLK_RPU_L_MUX>,
		      <&clk_core CLK_RPU_L_PLL_MUX>,
		      <&clk_core CLK_RPU_V_DIV>,
		      <&clk_core CLK_RPU_V_PLL_MUX>,
		      <&clk_core CLK_RPU_CORE_DIV>,
		      <&clk_core CLK_WIFI_PLL_MUX>,
		      <&clk_core CLK_WIFI_DIV4_MUX>,
		      <&clk_core CLK_WIFI_DIV8_MUX>,
		      <&clk_core CLK_RPU_SLEEP_DIV>,
		      <&clk_core CLK_WIFI_PLL>,
		      <&clk_core CLK_RPU_CORE>;
	      assigned-clock-parents = <0>,
		      <&clk_core CLK_RPU_L_PLL_MUX>,
		      <&clk_core CLK_RPU_L_PLL>,
		      <0>,
		      <&clk_core CLK_RPU_V_PLL>,
		      <0>,
		      <&clk_core CLK_WIFI_PLL>,
		      <&clk_core CLK_WIFI_DIV4>,
		      <&clk_core CLK_WIFI_DIV8>,
		      <0>,
		      <0>,
		      <0>;
	      assigned-clock-rates = <559000000>,
		      <0>,
		      <0>,
		      <598000000>,
		      <0>,
		      <320000000>,
		      <0>,
		      <0>,
		      <0>,
		      <52000>,
		      <320000000>,
		      <320000000>;
	      io-channels = <&adc 4>, <&adc 5>;
      };
```
